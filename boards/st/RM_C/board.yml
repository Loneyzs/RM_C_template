## boards/st/RM_C/board.yml
```yaml
board:
  name: rm_c
  full_name: RoboMaster Development Board Type C
  vendor: st
  socs:
    - name: stm32f407xx
```

## boards/st/RM_C/rm_c_defconfig
```kconfig
# SPDX-License-Identifier: Apache-2.0

# Enable MPU
CONFIG_ARM_MPU=y

# Enable HW stack protection
CONFIG_HW_STACK_PROTECTION=y

# Console via SEGGER RTT (J-Link RTT Viewer / west debugserver)
# USART1 (丝印 UART2) 不再作为 console/shell back-end，由应用自由使用。
CONFIG_CONSOLE=y
CONFIG_USE_SEGGER_RTT=y
CONFIG_RTT_CONSOLE=y
CONFIG_UART_CONSOLE=n

# GPIO
CONFIG_GPIO=y
```

## build_imu/Kconfig/arch/Kconfig
```kconfig
# Load Zephyr Arch Kconfig descriptions.
osource "E:/zephyr_workspace/zephyr/arch/rx/Kconfig"
osource "E:/zephyr_workspace/zephyr/arch/x86/Kconfig"
osource "E:/zephyr_workspace/zephyr/arch/xtensa/Kconfig"
osource "E:/zephyr_workspace/zephyr/arch/sparc/Kconfig"
osource "E:/zephyr_workspace/zephyr/arch/riscv/Kconfig"
osource "E:/zephyr_workspace/zephyr/arch/posix/Kconfig"
osource "E:/zephyr_workspace/zephyr/arch/openrisc/Kconfig"
osource "E:/zephyr_workspace/zephyr/arch/mips/Kconfig"
osource "E:/zephyr_workspace/zephyr/arch/arm64/Kconfig"
osource "E:/zephyr_workspace/zephyr/arch/arm/Kconfig"
osource "E:/zephyr_workspace/zephyr/arch/arc/Kconfig"
```

## build_imu/Kconfig/boards/Kconfig.defconfig
```kconfig
# Load Zephyr board defconfig descriptions.
osource "E:/zephyr_repo/RM_C_template/boards/st/RM_C/Kconfig.defconfig"
```

## build_imu/Kconfig/boards/Kconfig.rm_c
```kconfig
# Load board Kconfig descriptions.
osource "E:/zephyr_repo/RM_C_template/boards/st/RM_C/Kconfig.rm_c"
```

## build_imu/Kconfig/boards/Kconfig.sysbuild.tmp
```kconfig
# Load Sysbuild board Kconfig descriptions.
osource "E:/zephyr_repo/RM_C_template/boards/st/RM_C/Kconfig.sysbuild"
```

## build_imu/Kconfig/soc/Kconfig.tmp
```kconfig
# Load Zephyr SoC Kconfig descriptions.
osource "E:/zephyr_workspace/zephyr/soc/xlnx/zynqmp/Kconfig"
osource "E:/zephyr_workspace/zephyr/soc/xlnx/zynq7000/Kconfig"
osource "E:/zephyr_workspace/zephyr/soc/xlnx/versalnet/Kconfig"
osource "E:/zephyr_workspace/zephyr/soc/xlnx/versal2/Kconfig"
osource "E:/zephyr_workspace/zephyr/soc/xlnx/versal/Kconfig"
osource "E:/zephyr_workspace/zephyr/soc/xen/Kconfig"
osource "E:/zephyr_workspace/zephyr/soc/wch/ch32v/Kconfig"
osource "E:/zephyr_workspace/zephyr/soc/ti/simplelink/Kconfig"
osource "E:/zephyr_workspace/zephyr/soc/ti/mspm0/Kconfig"
osource "E:/zephyr_workspace/zephyr/soc/ti/lm3s6965/Kconfig"
osource "E:/zephyr_workspace/zephyr/soc/ti/k3/Kconfig"
osource "E:/zephyr_workspace/zephyr/soc/telink/tlsr/Kconfig"
osource "E:/zephyr_workspace/zephyr/soc/syna/sr100/Kconfig"
osource "E:/zephyr_workspace/zephyr/soc/starfive/jh71xx/Kconfig"
osource "E:/zephyr_workspace/zephyr/soc/st/stm32/Kconfig"
osource "E:/zephyr_workspace/zephyr/soc/snps/qemu_arc/Kconfig"
osource "E:/zephyr_workspace/zephyr/soc/snps/nsim/arc_v/Kconfig"
osource "E:/zephyr_workspace/zephyr/soc/snps/nsim/arc_classic/Kconfig"
osource "E:/zephyr_workspace/zephyr/soc/snps/hsdk4xd/Kconfig"
osource "E:/zephyr_workspace/zephyr/soc/snps/hsdk/Kconfig"
osource "E:/zephyr_workspace/zephyr/soc/snps/emsk/Kconfig"
osource "E:/zephyr_workspace/zephyr/soc/snps/emsdp/Kconfig"
osource "E:/zephyr_workspace/zephyr/soc/snps/arc_iot/Kconfig"
osource "E:/zephyr_workspace/zephyr/soc/silabs/Kconfig"
osource "E:/zephyr_workspace/zephyr/soc/sifli/sf32/Kconfig"
osource "E:/zephyr_workspace/zephyr/soc/sifive/sifive_freedom/Kconfig"
osource "E:/zephyr_workspace/zephyr/soc/sensry/Kconfig"
osource "E:/zephyr_workspace/zephyr/soc/rockchip/Kconfig"
osource "E:/zephyr_workspace/zephyr/soc/renode/riscv_virtual/Kconfig"
osource "E:/zephyr_workspace/zephyr/soc/renode/cortex_r8_virtual/Kconfig"
osource "E:/zephyr_workspace/zephyr/soc/renesas/smartbond/Kconfig"
osource "E:/zephyr_workspace/zephyr/soc/renesas/rz/Kconfig"
osource "E:/zephyr_workspace/zephyr/soc/renesas/rx/Kconfig"
osource "E:/zephyr_workspace/zephyr/soc/renesas/rcar/Kconfig"
osource "E:/zephyr_workspace/zephyr/soc/renesas/ra/Kconfig"
osource "E:/zephyr_workspace/zephyr/soc/realtek/fingerprint/Kconfig"
osource "E:/zephyr_workspace/zephyr/soc/realtek/ec/Kconfig"
osource "E:/zephyr_workspace/zephyr/soc/realtek/bee/Kconfig"
osource "E:/zephyr_workspace/zephyr/soc/realtek/ameba/Kconfig"
osource "E:/zephyr_workspace/zephyr/soc/raspberrypi/rpi_pico/Kconfig"
osource "E:/zephyr_workspace/zephyr/soc/quicklogic/eos_s3/Kconfig"
osource "E:/zephyr_workspace/zephyr/soc/qemu/virt_riscv/Kconfig"
osource "E:/zephyr_workspace/zephyr/soc/qemu/or1k/Kconfig"
osource "E:/zephyr_workspace/zephyr/soc/qemu/malta/Kconfig"
osource "E:/zephyr_workspace/zephyr/soc/openisa/rv32m1/Kconfig"
osource "E:/zephyr_workspace/zephyr/soc/openhwgroup/cva6/Kconfig"
osource "E:/zephyr_workspace/zephyr/soc/oct/osd32mp15x/Kconfig"
osource "E:/zephyr_workspace/zephyr/soc/nxp/s32/Kconfig"
osource "E:/zephyr_workspace/zephyr/soc/nxp/rw/Kconfig"
osource "E:/zephyr_workspace/zephyr/soc/nxp/mcx/Kconfig"
osource "E:/zephyr_workspace/zephyr/soc/nxp/lpc/Kconfig"
osource "E:/zephyr_workspace/zephyr/soc/nxp/layerscape/Kconfig"
osource "E:/zephyr_workspace/zephyr/soc/nxp/kinetis/Kconfig"
osource "E:/zephyr_workspace/zephyr/soc/nxp/imxrt/Kconfig"
osource "E:/zephyr_workspace/zephyr/soc/nxp/imx/Kconfig"
osource "E:/zephyr_workspace/zephyr/soc/nuvoton/numicro/Kconfig"
osource "E:/zephyr_workspace/zephyr/soc/nuvoton/numaker/Kconfig"
osource "E:/zephyr_workspace/zephyr/soc/nuvoton/npcx/Kconfig"
osource "E:/zephyr_workspace/zephyr/soc/nuvoton/npcm/Kconfig"
osource "E:/zephyr_workspace/zephyr/soc/nordic/Kconfig"
osource "E:/zephyr_workspace/zephyr/soc/neorv32/Kconfig"
osource "E:/zephyr_workspace/zephyr/soc/native/inf_clock/Kconfig"
osource "E:/zephyr_workspace/zephyr/soc/microchip/sam/sama7/Kconfig"
osource "E:/zephyr_workspace/zephyr/soc/microchip/sam/sam_d5x_e5x/Kconfig"
osource "E:/zephyr_workspace/zephyr/soc/microchip/pic64/Kconfig"
osource "E:/zephyr_workspace/zephyr/soc/microchip/pic32c/pic32cz_ca/Kconfig"
osource "E:/zephyr_workspace/zephyr/soc/microchip/pic32c/pic32cx_sg/Kconfig"
osource "E:/zephyr_workspace/zephyr/soc/microchip/pic32c/pic32cm_pl/Kconfig"
osource "E:/zephyr_workspace/zephyr/soc/microchip/pic32c/pic32cm_jh/Kconfig"
osource "E:/zephyr_workspace/zephyr/soc/microchip/miv/Kconfig"
osource "E:/zephyr_workspace/zephyr/soc/microchip/mec/Kconfig"
osource "E:/zephyr_workspace/zephyr/soc/mediatek/mt8xxx/Kconfig"
osource "E:/zephyr_workspace/zephyr/soc/lowrisc/opentitan/Kconfig"
osource "E:/zephyr_workspace/zephyr/soc/litex/Kconfig"
osource "E:/zephyr_workspace/zephyr/soc/ite/ec/Kconfig"
osource "E:/zephyr_workspace/zephyr/soc/intel/wildcat_lake/Kconfig"
osource "E:/zephyr_workspace/zephyr/soc/intel/raptor_lake/Kconfig"
osource "E:/zephyr_workspace/zephyr/soc/intel/panther_lake/Kconfig"
osource "E:/zephyr_workspace/zephyr/soc/intel/lakemont/Kconfig"
osource "E:/zephyr_workspace/zephyr/soc/intel/intel_socfpga_std/Kconfig"
osource "E:/zephyr_workspace/zephyr/soc/intel/intel_socfpga/Kconfig"
osource "E:/zephyr_workspace/zephyr/soc/intel/intel_niosv/Kconfig"
osource "E:/zephyr_workspace/zephyr/soc/intel/intel_ish/Kconfig"
osource "E:/zephyr_workspace/zephyr/soc/intel/intel_adsp/Kconfig"
osource "E:/zephyr_workspace/zephyr/soc/intel/elkhart_lake/Kconfig"
osource "E:/zephyr_workspace/zephyr/soc/intel/atom/Kconfig"
osource "E:/zephyr_workspace/zephyr/soc/intel/apollo_lake/Kconfig"
osource "E:/zephyr_workspace/zephyr/soc/intel/alder_lake/Kconfig"
osource "E:/zephyr_workspace/zephyr/soc/infineon/psoc4/Kconfig"
osource "E:/zephyr_workspace/zephyr/soc/infineon/edge/Kconfig"
osource "E:/zephyr_workspace/zephyr/soc/infineon/cat3/Kconfig"
osource "E:/zephyr_workspace/zephyr/soc/infineon/cat1c/Kconfig"
osource "E:/zephyr_workspace/zephyr/soc/infineon/cat1b/Kconfig"
osource "E:/zephyr_workspace/zephyr/soc/infineon/cat1a/Kconfig"
osource "E:/zephyr_workspace/zephyr/soc/gd/gd32/Kconfig"
osource "E:/zephyr_workspace/zephyr/soc/gaisler/leon3/Kconfig"
osource "E:/zephyr_workspace/zephyr/soc/gaisler/gr716a/Kconfig"
osource "E:/zephyr_workspace/zephyr/soc/focaltech/Kconfig"
osource "E:/zephyr_workspace/zephyr/soc/espressif/Kconfig"
osource "E:/zephyr_workspace/zephyr/soc/ene/kb1200/Kconfig"
osource "E:/zephyr_workspace/zephyr/soc/ene/kb106x/Kconfig"
osource "E:/zephyr_workspace/zephyr/soc/elan/em32f967/Kconfig"
osource "E:/zephyr_workspace/zephyr/soc/egis/Kconfig"
osource "E:/zephyr_workspace/zephyr/soc/efinix/sapphire/Kconfig"
osource "E:/zephyr_workspace/zephyr/soc/cdns/xtensa_sample_controller/Kconfig"
osource "E:/zephyr_workspace/zephyr/soc/cdns/swerv/Kconfig"
osource "E:/zephyr_workspace/zephyr/soc/cdns/sample_controller32/Kconfig"
osource "E:/zephyr_workspace/zephyr/soc/cdns/dc233c/Kconfig"
osource "E:/zephyr_workspace/zephyr/soc/brcm/bcmvk/Kconfig"
osource "E:/zephyr_workspace/zephyr/soc/brcm/bcm2712/Kconfig"
osource "E:/zephyr_workspace/zephyr/soc/brcm/bcm2711/Kconfig"
osource "E:/zephyr_workspace/zephyr/soc/blackberry/qnxhv_vm/Kconfig"
osource "E:/zephyr_workspace/zephyr/soc/bflb/Kconfig"
osource "E:/zephyr_workspace/zephyr/soc/atmel/sam0/Kconfig"
osource "E:/zephyr_workspace/zephyr/soc/atmel/sam/Kconfig"
osource "E:/zephyr_workspace/zephyr/soc/aspeed/Kconfig"
osource "E:/zephyr_workspace/zephyr/soc/arm/Kconfig"
osource "E:/zephyr_workspace/zephyr/soc/arm/beetle/Kconfig"
osource "E:/zephyr_workspace/zephyr/soc/antmicro/myra/Kconfig"
osource "E:/zephyr_workspace/zephyr/soc/andestech/Kconfig"
osource "E:/zephyr_workspace/zephyr/soc/amd/acp_6_0/Kconfig"
osource "E:/zephyr_workspace/zephyr/soc/ambiq/Kconfig"
osource "E:/zephyr_workspace/zephyr/soc/allwinner/sun8i_h3/Kconfig"
osource "E:/zephyr_workspace/zephyr/soc/alif/ensemble/Kconfig"
osource "E:/zephyr_workspace/zephyr/soc/aesc/Kconfig"
osource "E:/zephyr_workspace/zephyr/soc/adi/max32/Kconfig"
```
